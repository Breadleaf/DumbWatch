#include <Arduino.h>
#include <Wire.h>
#include <Adafruit_GFX.h>
#include <Adafruit_SSD1306.h>
#include <Fonts/TomThumb.h>

unsigned long lastPingTime = 0;
const unsigned long pingInterval = 4000;

// example code below

#define OLED_SDA 6
#define OLED_SCL 7

arduino::MbedI2C myWire(OLED_SDA, OLED_SCL);

#define SCREEN_WIDTH 128
#define SCREEN_HEIGHT 32

#define SCREEN_ADDRESS 0x3C

Adafruit_SSD1306 display(SCREEN_WIDTH, SCREEN_HEIGHT, &myWire);

// https://jlamch.net/MXChipWelcome/
const int catImg_width = 128;
const int catImg_height = 32;
const unsigned char catImg[] PROGMEM = {
    0xff, 0xff, 0xff, 0xff, 0xff, 0xff, 0xff, 0xff, 0xff, 0xff, 0xff, 0xff, 0xff, 0xff, 0xff, 0xff,
    0xff, 0xff, 0xff, 0xff, 0xff, 0x6d, 0xff, 0xfe, 0x7b, 0xff, 0xff, 0xff, 0xff, 0xff, 0xff, 0x9f,
    0xff, 0xff, 0xff, 0xff, 0xff, 0x6d, 0x96, 0x78, 0x79, 0x49, 0xa2, 0x92, 0x76, 0x85, 0x9c, 0x9f,
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    0xff, 0xff, 0xff, 0xc7, 0xff, 0xff, 0xff, 0xff, 0xff, 0xff, 0xff, 0xff, 0xff, 0xff, 0xe0, 0x0f};

// example code above

void screen_greetingScreen(String, String);
void screen_imageScreen(const int, const int, const unsigned char[]);

void setup()
{
  Serial.begin(115200); // serial monitor
  Serial1.begin(9600);  // serial hardware bus -> HC-06 pins 0 (TXD) and 1 (RXD)

  // wait for serial
  delay(1000);

  myWire.begin();

  // example code below

  if (!display.begin(SSD1306_SWITCHCAPVCC, SCREEN_ADDRESS))
  {
    Serial.println(F("SSD1306 not found"));
    while (1)
      ;
  }

  display.clearDisplay();

  // example code above
}

int counter = 0;
unsigned long incrementCounterInterval = 1000;
unsigned long lastIncrementTime = 0;

unsigned long catTime = 10000;

unsigned long askForTimeInterval = 2000;
unsigned long laskAskTime = 0;

void loop()
{
  unsigned long currentTime = millis();

  if (currentTime - lastPingTime >= pingInterval)
  {
    lastPingTime = currentTime;
    Serial1.println("Hello World");
  }

  if (Serial1.available() > 0)
  {
    char incomingByte = Serial1.read();
    Serial.print(incomingByte);
  }

  if (currentTime - laskAskTime >= askForTimeInterval)
  {
    laskAskTime = currentTime;
    Serial1.println("GET_TIME");
  }

  if (currentTime >= catTime)
  {
    screen_imageScreen(catImg_width, catImg_height, catImg);
  }
  else if (currentTime - lastIncrementTime >= incrementCounterInterval)
  {
    lastIncrementTime = currentTime;
    screen_greetingScreen("[User]", String(counter++));
  }
}

void screen_greetingScreen(String name, String time)
{
  display.clearDisplay();

  display.setTextColor(SSD1306_WHITE);
  display.setFont(&TomThumb);
  display.setTextSize(1);
  display.setCursor(0, 10);
  display.print("Good Morning ");
  display.print(name);
  display.println("!");

  // display.setCursor(0, 25);
  display.print("Current Time: ");
  display.println(time);

  display.display();
}

void screen_imageScreen(const int width, const int height, const unsigned char image[])
{
  display.clearDisplay();
  display.drawBitmap(0, 0, image, width, height, SSD1306_WHITE);
  display.display();
}