// https://www.seeedstudio.com/Seeed-Studio-XIAO-ESP32C5-p-6609.html?srsltid=AfmBOoqKY_8gVJ4JI-A3QvkJrC87kX2DiGXrgdFV1Vb3hkctq9RQkFrs

#include <Arduino.h>
#include <Wire.h>
#include <Adafruit_GFX.h>
#include <Adafruit_SSD1306.h>
#include <Fonts/TomThumb.h>

#include "Types.hpp"
#include "Tasks.hpp"
#include "InputHandler.hpp"
#include "BatteryHandler.hpp"
#include "UI.hpp"

#define I2C_DATA D4 // SDA
#define I2C_CLCK D5 // SCK / SCL

#define SCREEN_WIDTH 128
#define SCREEN_HEIGHT 32
#define SCREEN_ADDRESS 0x3C

// https://jlamch.net/MXChipWelcome/
const int catImg_width = 128;
const int catImg_height = 32;
const unsigned char catImg[] PROGMEM = {
    0xff, 0xff, 0xff, 0xff, 0xff, 0xff, 0xff, 0xff, 0xff, 0xff, 0xff, 0xff, 0xff, 0xff, 0xff, 0xff,
    0xff, 0xff, 0xff, 0xff, 0xff, 0x6d, 0xff, 0xfe, 0x7b, 0xff, 0xff, 0xff, 0xff, 0xff, 0xff, 0x9f,
    0xff, 0xff, 0xff, 0xff, 0xff, 0x6d, 0x96, 0x78, 0x79, 0x49, 0xa2, 0x92, 0x76, 0x85, 0x9c, 0x9f,
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    0xff, 0xff, 0xff, 0xc7, 0xff, 0xff, 0xff, 0xff, 0xff, 0xff, 0xff, 0xff, 0xff, 0xff, 0xe0, 0x0f};

Adafruit_SSD1306 display(SCREEN_WIDTH, SCREEN_HEIGHT, &Wire, -1);

InputHandler<3> inputHandler({D2, D1, D0});
BatteryHandler batteryHandler;

UI ui(display, batteryHandler);

void setup()
{
  Serial.begin(115200);

  Wire.begin(I2C_DATA, I2C_CLCK);
  Wire.setClock(100000);

  inputHandler.begin();
  batteryHandler.begin();

  delay(1000);

  if (!display.begin(SSD1306_SWITCHCAPVCC, SCREEN_ADDRESS, false, false))
  {
    Serial.println(F("SSD1306 not found"));
    while (1)
      ;
  }

  display.clearDisplay();

  display.setTextSize(1);
  display.setTextColor(SSD1306_WHITE);
  display.setCursor(0, 0);
  display.print("DumbWatch Loading...");
  display.display();

  batteryHandler.UpdateState();
  ui.MarkDirty();
}

tasks::ScheduledTask<tasks::BaseTaskData> InputUpdateTask(
    tasks::BaseTaskData{.interval = 50},
    [](const types::TimeMS_t currentTime)
    {
      static auto &task = InputUpdateTask;
      if (currentTime - task.data.lastRun >= task.data.interval)
      {
        inputHandler.UpdateState();

        if (inputHandler.buttons[0].pressed())
          ui.SetScreen(UI::Screen::HOME);
        if (inputHandler.buttons[1].pressed())
          ui.SetScreen(UI::Screen::BATTERY);
        if (inputHandler.buttons[2].pressed())
          ui.SetScreen(UI::Screen::SETTINGS);

        task.data.lastRun = millis();
      }
    });

tasks::ScheduledTask<tasks::BaseTaskData> BatteryUpdateTask(
    tasks::BaseTaskData{.interval = 5000},
    [](const types::TimeMS_t currentTime)
    {
      static auto &task = BatteryUpdateTask;
      if (currentTime - task.data.lastRun >= task.data.interval)
      {
        float oldVoltage = batteryHandler.voltage;
        int oldPercentage = batteryHandler.percentage;

        batteryHandler.UpdateState();

        if (oldVoltage != batteryHandler.voltage || oldPercentage != batteryHandler.percentage)
        {
          ui.MarkDirty();

          Serial.print("Battery: ");
          Serial.print(batteryHandler.voltage, 2);
          Serial.print("V ");
          Serial.print(batteryHandler.percentage);
          Serial.println("%");
        }

        task.data.lastRun = millis();
      }
    });

tasks::ScheduledTask<tasks::BaseTaskData> UIRenderTask(
    tasks::BaseTaskData{.interval = 16},
    [](const types::TimeMS_t currentTime)
    {
      static auto &task = UIRenderTask;
      if (currentTime - task.data.lastRun >= task.data.interval)
      {
        ui.Render();
        task.data.lastRun = millis();
      }
    });

const size_t SCHEDULE_LEN = 3;
std::array<tasks::ScheduledTaskInterface *, SCHEDULE_LEN> schedule = {
    &InputUpdateTask,
    &BatteryUpdateTask,
    &UIRenderTask,
};

void loop()
{
  types::TimeMS_t currentTime = millis();
  for (auto task : schedule)
  {
    task->run(currentTime);
    currentTime = millis();
  }

  delay(10);
}